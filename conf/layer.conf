## conf/layer.conf
```bitbake
# We have a conf and classes directory, add to BBPATH
BBPATH .= ":${LAYERDIR}"

# We have recipes-* directories, add to BBFILES
BBFILES += "${LAYERDIR}/recipes-*/*/*.bb \
            ${LAYERDIR}/recipes-*/*/*.bbappend"

BBFILE_COLLECTIONS += "meta-senzacarta"
BBFILE_PATTERN_meta-senzacarta = "^${LAYERDIR}/"
BBFILE_PRIORITY_meta-senzacarta = "8"

LAYERDEPENDS_meta-senzacarta = "core"
LAYERSERIES_COMPAT_meta-senzacarta = "hardknott"

# Add the Freescale license
FSL_EULA_FILE = "${LAYERDIR}/EULA"
FSL_EULA_FILE_MD5SUM = "03bcadc8dc0a788f66ca9e2b89f56c6f"

IMAGE_BOOT_FILES += "imx7d-senzacarta.dtb zImage"
```
